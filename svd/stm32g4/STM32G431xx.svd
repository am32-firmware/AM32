# STM32G431xx register map
File version: 1.0
CPU: CM4 r0p1, little endian, MPU, FPU, 4 interrupt priority bits
Registers are 32-bit, read-write, reset 0x0 unless marked. A register's access mark holds for its fields unless they carry their own. Offsets are from the block's base; lines under a group give offsets from that group; [hi:lo] are bit positions; {n}, {i} and the like mark numbered series; 'fields as' and 'values as' point back to an identical list; <NAME> marks a mode.

## Memory map
0x40000000 TIM2 size 0x400 — Advanced-timers
0x40000400 TIM3 size 0x400
0x40000800 TIM4 size 0x400
0x40001000 TIM6 size 0x400 — Basic-timers
0x40001400 TIM7 size 0x400
0x40002000 CRS size 0x400
0x40002400 TAMP size 0x400 — Tamper and backup registers
0x40002800 RTC size 0x400 — Real-time clock
0x40002C00 WWDG size 0x400 — WinWATCHDOG
0x40003000 IWDG size 0x400 — System window watchdog
0x40003800 SPI2 size 0x400
0x40003C00 SPI3 size 0x400
0x40004400 USART2 size 0x400
0x40004800 USART3 size 0x400
0x40004C00 UART4 size 0x400 — Universal synchronous asynchronous receiver transmitter
0x40005400 I2C1 size 0x400 — Inter-integrated circuit
0x40005800 I2C2 size 0x400
0x40005C00 USB_FS_device size 0x400
0x40006400 FDCAN1 size 0x400
0x40007000 PWR size 0x400 — Power control
0x40007800 I2C3 size 0x400
0x40007C00 LPTIMER1 size 0x400 — Low power timer
0x40008000 LPUART1 size 0x400 — Universal synchronous asynchronous receiver transmitter
0x4000A000 UCPD1 size 0x400
0x4000A400 FDCAN size 0x400
0x40010000 SYSCFG size 0x2A — System configuration controller
0x40010030 VREFBUF size 0x1D0 — Voltage reference buffer
0x40010200 COMP size 0x100 — Comparator control and status register
0x40010300 OPAMP size 0x100 — Operational amplifiers
0x40010400 EXTI size 0x400 — External interrupt/event controller
0x40012C00 TIM1 size 0x400 — Advanced-timers
0x40013000 SPI1 size 0x400 — Serial peripheral interface/Inter-IC sound
0x40013400 TIM8 size 0x400
0x40013800 USART1 size 0x400 — Universal synchronous asynchronous receiver transmitter
0x40014000 TIM15 size 0x400 — General purpose timers
0x40014400 TIM16 size 0x400 — General purpose timers
0x40014800 TIM17 size 0x400
0x40015400 SAI size 0x400 — Serial audio interface
0x40020000 DMA1 size 0x400 — DMA controller
0x40020400 DMA2 size 0x400
0x40020800 DMAMUX size 0x400
0x40020C00 CORDIC size 0x400 — CORDIC Co-processor
0x40021000 RCC size 0x400 — Reset and clock control
0x40021400 FMAC size 0xC00 — Filter Math Accelerator
0x40022000 FLASH size 0x400
0x40023000 CRC size 0x400 — Cyclic redundancy check calculation unit
0x48000000 GPIOA size 0x400 — General-purpose I/Os
0x48000400 GPIOB size 0x400 — General-purpose I/Os
0x48000800 GPIOC size 0x400 — General-purpose I/Os
0x48000C00 GPIOD size 0x400
0x48001000 GPIOE size 0x400
0x48001400 GPIOF size 0x400
0x48001800 GPIOG size 0x400
0x50000000 ADC1 size 0xD0 — Analog-to-Digital Converter
0x50000100 ADC2 size 0xD0
0x50000300 ADC12_Common size 0x11 — Analog-to-Digital Converter
0x50000700 ADC345_Common size 0x11
0x50000800 DAC1 size 0x400 — Digital-to-analog converter
0x50000C00 DAC2 size 0x400
0x50001000 DAC3 size 0x400
0x50001400 DAC4 size 0x400
0x50060000 AES size 0x400 — Advanced encryption standard hardware accelerator
0x50060800 RNG size 0x400 — Random number generator
0xE000E008 SCB_ACTRL size 0x5 — System control block ACTLR
0xE000E010 STK size 0x11 — SysTick timer
0xE000E040 SCB size 0x41 — System control block
0xE000E084 MPU size 0x15 — Memory protection unit
0xE000E100 NVIC size 0xE04 — Nested Vectored Interrupt Controller
0xE000EF08 FPU_CPACR size 0x5 — Floating point unit CPACR
0xE000EF34 FPU size 0xD — Floting point unit
0xE0042000 DBGMCU size 0x400 — Debug support

## Interrupts
0 WWDG (I2C2) — Window Watchdog interrupt
1 PVD_PVM (EXTI) — PVD through EXTI line detection
2 RTC_TAMP_CSS_LSE (RTC)
3 RTC_WKUP (RTC) — RTC Wakeup timer
4 FLASH
5 RCC
6 EXTI0 (EXTI) — EXTI Line0 interrupt
7 EXTI1 (EXTI) — EXTI Line1 interrupt
8 EXTI2 (EXTI) — EXTI Line2 interrupt
9 EXTI3 (EXTI) — EXTI Line3 interrupt
10 EXTI4 (EXTI) — EXTI Line4 interrupt
11 DMA1_CH1 (DMA1) — DMA1 channel 1 interrupt
12 DMA1_CH2 (DMA1) — DMA1 channel 2 interrupt
13 DMA1_CH3 (DMA1) — DMA1 channel 3 interrupt
14 DMA1_CH4 (DMA1) — DMA1 channel 4 interrupt
15 DMA1_CH5 (DMA1) — DMA1 channel 5 interrupt
16 DMA1_CH6 (DMA1) — DMA1 channel 6 interrupt
18 ADC1_2 (ADC1) — ADC1 and ADC2 global interrupt
19 USB_HP (EXTI)
20 USB_LP (EXTI)
21 fdcan1_intr1_it (EXTI)
22 fdcan1_intr0_it (EXTI)
23 EXTI9_5 (EXTI)
24 TIM1_BRK_TIM15 (TIM1)
25 TIM1_UP_TIM16 (TIM1)
26 TIM1_TRG_COM (TIM1)
27 TIM1_CC (TIM1) — TIM1 capture compare interrupt
28 TIM2
29 TIM3
30 TIM4
31 I2C1_EV (I2C1)
32 I2C1_ER (I2C1)
33 I2C2_EV (I2C2)
34 I2C2_ER (I2C2)
35 SPI1
36 SPI2
37 USART1
38 USART2
39 USART3
40 EXTI15_10 (EXTI)
41 RTC_ALARM (RTC)
42 USBWakeUP (EXTI)
43 TIM8_BRK (TIM8)
44 TIM8_UP (TIM8)
45 TIM8_TRG_COM (TIM8)
46 TIM8_CC (TIM1)
49 LPTIM1 (LPUART1)
51 SPI3
52 UART4
54 TIM6_DACUNDER (TIM6)
55 TIM7
56 DMA2_CH1 (DMA2)
57 DMA2_CH2 (DMA2)
58 DMA2_CH3 (DMA2)
59 DMA2_CH4 (DMA2)
60 DMA2_CH5 (DMA2)
63 UCPD1
64 COMP1_2_3 (COMP)
65 COMP4 (COMP) — COMP4_5_6
75 CRS (EXTI)
76 SAI
81 FPU — Floating point unit interrupt
85 AES
90 RNG
91 LPUART (LPUART1)
92 I2C3_EV (I2C3)
93 I2C3_ER (I2C3)
94 DMAMUX_OVR (DMAMUX)
97 DMA2_CH6 (DMA2)
100 Cordic (CORDIC)
101 FMAC
